## boards/st/my_board/board.yml
```yaml
board:
  name: my_board
  full_name: ST Nucleo F411RE Copy
  vendor: st
  socs:
    - name: stm32f411xe
```

## build/Kconfig/Kconfig.shield.defconfig
```kconfig
osource "/Users/hepmac/Workspace/zephyr_ws/tmpl_prj/boards/shields/*/Kconfig.defconfig"
```

## build/Kconfig/arch/Kconfig
```kconfig
# Load Zephyr Arch Kconfig descriptions.
osource "/Users/hepmac/zephyrproject/zephyr/arch/rx/Kconfig"
osource "/Users/hepmac/zephyrproject/zephyr/arch/x86/Kconfig"
osource "/Users/hepmac/zephyrproject/zephyr/arch/xtensa/Kconfig"
osource "/Users/hepmac/zephyrproject/zephyr/arch/sparc/Kconfig"
osource "/Users/hepmac/zephyrproject/zephyr/arch/riscv/Kconfig"
osource "/Users/hepmac/zephyrproject/zephyr/arch/posix/Kconfig"
osource "/Users/hepmac/zephyrproject/zephyr/arch/openrisc/Kconfig"
osource "/Users/hepmac/zephyrproject/zephyr/arch/mips/Kconfig"
osource "/Users/hepmac/zephyrproject/zephyr/arch/arm64/Kconfig"
osource "/Users/hepmac/zephyrproject/zephyr/arch/arm/Kconfig"
osource "/Users/hepmac/zephyrproject/zephyr/arch/arc/Kconfig"
```

## build/Kconfig/boards/Kconfig.defconfig
```kconfig
# Load Zephyr board defconfig descriptions.
osource "/Users/hepmac/Workspace/zephyr_ws/tmpl_prj/boards/st/Kconfig.defconfig"
```

## build/Kconfig/boards/Kconfig.my_board
```kconfig
# Load board Kconfig descriptions.
osource "/Users/hepmac/Workspace/zephyr_ws/tmpl_prj/boards/st/Kconfig.my_board"
```

## build/Kconfig/boards/Kconfig.sysbuild.tmp
```kconfig
# Load Sysbuild board Kconfig descriptions.
osource "/Users/hepmac/Workspace/zephyr_ws/tmpl_prj/boards/st/Kconfig.sysbuild"
```
